## conf/layer.conf
```bitbake
BBPATH .= ":${LAYERDIR}"

BBFILES += "${LAYERDIR}/recipes*/*/*.bb \
            ${LAYERDIR}/recipes*/*/*.bbappend"

BBFILE_COLLECTIONS += "crosstools"
BBFILE_PATTERN_crosstools := "^${LAYERDIR}/"
BBFILE_PRIORITY_crosstools = "9"

LAYERSERIES_CORENAMES = "StaffanoTheGreat"
LAYERSERIES_COMPAT_crosstools = "StaffanoTheGreat"
 
# Additional license directories.
#LICENSE_PATH += "${LAYERDIR}/files/custom-licenses"

LANGUAGES ?= "c,c++,ada"
```
